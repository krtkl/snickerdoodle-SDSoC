## sources/snickerdoodle-black.its
```
/dts-v1/;

/ {
	description = "U-Boot fitImage for snickerdoodle Linux kernel";
	#address-cells = <1>;

	images {
		kernel@0 {
			description = "Linux Kernel";
			data = /incbin/("./vmlinux.bin.gz");
			type = "kernel";
			arch = "arm";
			os = "linux";
			compression = "gzip";
			load = <0x8000>;
			entry = <0x8000>;
			hash@1 {
				algo = "md5";
			};
			hash@2 {
				algo = "sha1";
			};
		};

		fdt@0 {
			description = "Flattened Device Tree Blob";
			data = /incbin/("./dts/snickerdoodle-black.dtb");
			type = "flat_dt";
			arch = "arm";
			compression = "none";
			hash@1 {
				algo = "md5";
			};
			hash@2 {
				algo = "sha1";
			};
		};

		ramdisk@0 {
			description = "RAMDisk";
			data = /incbin/("./ramdisk.image.gz");
			type = "ramdisk";
			arch = "arm";
			os = "linux";
			compression = "gzip";
			hash@1 {
				algo = "md5";
			};
			hash@2 {
				algo = "sha1";
			};
		};
	};

	configurations {
		default = "conf@1";
		conf@1 {
			description = "Linux kernel, FDT and RAMDisk multicomponent image";
			kernel = "kernel@0";
			fdt = "fdt@0";
			ramdisk = "ramdisk@0";
			hash@1 {
				algo = "sha1";
			};
		};

		conf@2 {
			description = "Linux kernel and FDT multicomponent image";
			kernel = "kernel@0";
			fdt = "fdt@0";
			hash@1 {
				algo = "sha1";
			};
		};
	};
};
```
